/dts-v1/;
/plugin/;

/ {
    fragment@0 {
        target-path = "/";
        __overlay__ {
            hieu_led_node {
                label = "hieu_led_device";
                gpios = <&gpio 23 0>; /* Pin 23, 0 = Active High */
                status = "okay";
            };
        };
    };
};